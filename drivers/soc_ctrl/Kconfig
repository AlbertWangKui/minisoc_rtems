## drivers/soc_ctrl/Kconfig
```kconfig
config DRIVER_SOC_CTRL
    bool "Enable SoC control driver"
    default y
    help
      Select this to enable SoC control driver support
```

## drivers/tach/Kconfig
```kconfig
config DRIVER_TACH
    bool "Enable TACH driver"
    default y
    help
      Select this to enable TACH (tachometer) driver support
```

## drivers/trng/Kconfig
```kconfig
config DRIVER_TRNG
    bool "Enable TRNG driver"
    default y
    help
      Select this to enable TRNG (True Random Number Generator) driver support

choice
    prompt "trng driver select"
    depends on DRIVER_TRNG

    config DRIVER_TRNG_DW
        bool "DesignWare TRNG driver"
    config DRIVER_TRNG_TH
        bool "TH TRNG driver"
endchoice

config DRIVER_TRNG_API_TEST
    bool "Enable TRNG API test"
    default n
    depends on DRIVER_TRNG
    help
        Select this to enable TRNG API test
```

## drivers/uart/Kconfig
```kconfig
config DRIVER_UART
    bool "Enable UART driver"
    default y
    help
      Select this to enable UART driver support
```

## drivers/wdt/Kconfig
```kconfig
config DRIVER_WDT
    bool "Enable Watchdog driver"
    default y
    help
      Select this to enable Watchdog timer driver support
```
