## Kconfig
```kconfig
mainmenu "minisoc FW Configuration"

source "bsp/Kconfig"
source "drivers/Kconfig"
source "components/Kconfig"
source "bsp/shared/osp/Kconfig"
```

## bsp/Kconfig
```kconfig
choice
    prompt "cpu arch select"
    config ARCH_ARMV7_R5
        bool "armv7-r5"
    config ARCH_ARMV8_A72
        bool "armv8-a72"
endchoice

menu "bsp select"

choice
    prompt "Bsp select"
    config BSP_TIANHE
        bool "bsp tianhe"
endchoice

source "bsp/tianhe/Kconfig"

choice
    prompt "Platform select"
    config PLATFORM_FPGA
        bool "platform fpga"
    config PLATFORM_EMU
        bool "platform emu"
    config PLATFORM_ASIC
        bool "platform asic"
endchoice

menu "fpga platform select"
    depends on PLATFORM_FPGA
        choice
            prompt "FPGA select"
            config PLATFORM_FPGA_S2C
                bool "platform fpga s2c"
            config PLATFORM_FPGA_HAPS
                bool "platform fpga haps"
            config PLATFORM_FPGA_VU19P
                bool "platform fpga vu19p"
            config PLATFORM_FPGA_1902
                bool "platform fpga 1902"
        endchoice
endmenu

menu "emu platform select"
    depends on PLATFORM_EMU
        choice
            prompt "EMU select"
            config PLATFORM_EMU_PZ1
                bool "platform emu pz1"
            config PLATFORM_EMU_VEL
                bool "platform fpga veloce"
        endchoice
endmenu

endmenu
```

## bsp/shared/osp/Kconfig
```kconfig
menu "Osp"

config ENABLE_OSP
    bool "Enable OSP"
    default y
    help
      Enable OSP (Operating System Porting) support
endmenu
```

## bsp/tianhe/Kconfig
```kconfig
menu "tianhe bsp"
	depends on BSP_TIANHE

    config BSP_NAME
        string
        default "tianhe"

    # select special peripherals for this bsp.
endmenu
```

## components/Kconfig
```kconfig
menu "Components"


source "components/misc/Kconfig"

menu "CLI"
config ENABLE_CLI
    bool "Enable CLI"
    default y
    help
      Enable CLI (Command Line Interface) support

  choice
      prompt "Shell implementation"
      depends on ENABLE_CLI
      default ENABLE_DSHELL
      config ENABLE_DSHELL
          bool "Enable DSHELL"
          help
            Enable DSHELL shell implementation
      config ENABLE_CLI_CORE
          bool "Enable CLI Core"
          help
            Enable CLI Core shell implementation
  endchoice

  config MAX_USHELL_CMD_NUM
    depends on ENABLE_DSHELL
    int "Max ushell cmd num"
    default 1024
    help
      Set ushell cmd number
endmenu

menu "json"
config ENABLE_JSON
    bool "enable json api"
    default n
    help
        enable json api
source "components/core_json/Kconfig"
endmenu

menu "Flash Partition"
config ENABLE_PARTITION_TABLE
    bool "Enable partition table"
    default y
    select DRIVER_QFLASH
    help
        enable flash partition table

config PARTITION_TABLE_DUMP
    bool "Enable partition table dump api"
    default n
    select ENABLE_PARTITION_TABLE
    help
        enable flash partition table dump function
endmenu

menu "SBR"
config ENABLE_SBR_API
    bool "Enable SBR API"
    select ENABLE_VERIFICATION
    select ENABLE_PARTITION_TABLE
    default y
    help
        enable SBR

config DUMP_SBR
    bool "print sbr contents when drivers get it"
    depends on ENABLE_SBR_API
    default y
    help
        dump sbr info when driver get the sbr config

config SBR_IMG_IN_RAM
    bool "SBR image is in RAM"
    default y
    help
        enable this when sbr image is in RAM
endmenu

endmenu
```

## components/cli_core/Kconfig
```kconfig
menu "CLI CORE"

config ENABLE_CLI_CORE
    bool "Enable CLI Core"
    default n
    help
      Enable CLI Core component for command line interface

endmenu
```

## components/core_json/Kconfig
```kconfig
menu "coreJson from FreeRTOS"

config CORE_JSON
    bool "coreJson"
    depends on ENABLE_JSON
    default y
    help
      Select this to use coreJson component

choice
    prompt "Json Position Select"
    depends on CORE_JSON
    default JSON_IN_SRAM
    config JSON_IN_SRAM
        bool "json file in sram"
    config JSON_IN_FLASH
        bool "json file in flash"
endchoice

endmenu
```

## components/misc/Kconfig
```kconfig
menu "verification lib"
config ENABLE_VERIFICATION
    bool "Enable verification functions"
    default n
    help
        Enable common verify algorithms (e.g., CRC16, checksum16)
endmenu
```

## configs/tianhe_emu_defconfig
```kconfig
CONFIG_ARCH_ARMV7_R5=y
# CONFIG_ARCH_ARMV8_A72 is not set

#
# bsp select
#
CONFIG_BSP_TIANHE=y

#
# tianhe bsp
#
CONFIG_BSP_NAME="tianhe"
# end of tianhe bsp

# CONFIG_PLATFORM_FPGA is not set
CONFIG_PLATFORM_EMU=y
# CONFIG_PLATFORM_ASIC is not set

#
# emu platform select
#
CONFIG_PLATFORM_EMU_PZ1=y
# CONFIG_PLATFORM_EMU_VEL is not set
# end of emu platform select
# end of bsp select

#
# Device Drivers
#
CONFIG_BRD_INIT=y
CONFIG_DRIVER_TIMER=y
CONFIG_DRIVER_UART=y
# CONFIG_DRIVER_SOC_CTRL is not set
CONFIG_DRIVER_GPIO=y
# CONFIG_DRIVER_GPIO_API_TEST is not set
CONFIG_DRIVER_WDT=y
CONFIG_DRIVER_SMBUS=y
CONFIG_DRIVER_SGPIO=y
# CONFIG_DRIVER_SGPIO_V1_1 is not set
# CONFIG_DRIVER_SGPIO_V2_0 is not set
CONFIG_DRIVER_SGPIO_V1_0=y
# CONFIG_DRIVER_SGPIO_API_TEST is not set
CONFIG_DRIVER_PWM=y
CONFIG_DRIVER_QFLASH=y
CONFIG_DRIVER_EFUSE=y
# CONFIG_DRIVER_EFUSE_V1 is not set
CONFIG_DRIVER_EFUSE_V2=y
CONFIG_DRIVER_TRNG=y
# CONFIG_DRIVER_TRNG_DW is not set
CONFIG_DRIVER_TRNG_TH=y
# CONFIG_DRIVER_TRNG_API_TEST is not set
CONFIG_DRIVER_SM3=y
CONFIG_DRIVER_SM2=y
CONFIG_DRIVER_SM4=y
# CONFIG_DRIVER_PVT is not set
# CONFIG_DRIVER_QSPI_CTRL is not set
CONFIG_DRIVER_OCM_ECC=y
CONFIG_DRIVER_TACH=y
# end of Device Drivers

#
# Components
#

#
# verification lib
#
CONFIG_ENABLE_VERIFICATION=y
# end of verification lib

#
# CLI
#
CONFIG_ENABLE_CLI=y
CONFIG_ENABLE_DSHELL=y
# CONFIG_ENABLE_CLI_CORE is not set
CONFIG_MAX_USHELL_CMD_NUM=1024
# end of CLI

#
# json
#
# CONFIG_ENABLE_JSON is not set

#
# coreJson from FreeRTOS
#
# end of coreJson from FreeRTOS
# end of json

#
# Flash Partition
#
CONFIG_ENABLE_PARTITION_TABLE=y
# CONFIG_PARTITION_TABLE_DUMP is not set
# end of Flash Partition

#
# SBR
#
CONFIG_ENABLE_SBR_API=y
CONFIG_DUMP_SBR=y
# CONFIG_SBR_IMG_IN_RAM is not set
# end of SBR
# end of Components

#
# Osp
#
CONFIG_ENABLE_OSP=y
# end of Osp
```

## drivers/Kconfig
```kconfig
menu "Device Drivers"

source "drivers/brd_init/Kconfig"
source "drivers/timer/Kconfig"
source "drivers/uart/Kconfig"
source "drivers/soc_ctrl/Kconfig"
source "drivers/gpio/Kconfig"
source "drivers/wdt/Kconfig"
source "drivers/smbus/Kconfig"
source "drivers/sgpio/Kconfig"
source "drivers/pwm/Kconfig"
source "drivers/qspi/Kconfig"
source "drivers/efuse/Kconfig"
source "drivers/trng/Kconfig"
source "drivers/sm3/Kconfig"
source "drivers/sm2/Kconfig"
source "drivers/sm4/Kconfig"
source "drivers/pvt/Kconfig"
source "drivers/qspi_ctrl/Kconfig"
source "drivers/ocm_ecc/Kconfig"
source "drivers/tach/Kconfig"

endmenu
```

## drivers/brd_init/Kconfig
```kconfig
config BRD_INIT
    bool "Enable generic register initialization at boot"
    default y
    help
        Enable generic register writing during system boot
```

## drivers/efuse/Kconfig
```kconfig
config DRIVER_EFUSE
    bool "Enable efuse driver"
    default y
    help
      Select this to enable efuse driver support

choice
    prompt "efuse driver select"
    depends on DRIVER_EFUSE

    config DRIVER_EFUSE_V1
        bool "efuse v1 driver"
    config DRIVER_EFUSE_V2
        bool "efuse v2 driver"
endchoice
```

## drivers/gpio/Kconfig
```kconfig
config DRIVER_GPIO
    bool "Enable GPIO driver"
    default y
    help
      Select this to enable GPIO driver support
config DRIVER_GPIO_API_TEST
    bool "Enable GPIO API test"
    default n
    depends on DRIVER_GPIO
    help
      Select this to enable GPIO API input validation testing
```

## drivers/i2c/Kconfig
```kconfig
config DRIVER_I2C
    bool "Enable I2C driver"
    default y
    help
      Select this to enable I2C driver support

config DRIVER_SMBUS
    depends on DRIVER_I2C
    bool "Enable SMBUS driver"
    default n
    help
      Select this to enable SMBUS driver support
```

## drivers/ocm_ecc/Kconfig
```kconfig
config DRIVER_OCM_ECC
    bool "Enable OCM ECC driver"
    default y
    help
      Select this to enable OCM ECC (Error Correction Code) driver support
```

## drivers/pvt/Kconfig
```kconfig
config DRIVER_PVT
    bool "Enable PVT driver"
    default n
    help
      Select this to enable PVT (Process, Voltage, Temperature) driver support

choice
    prompt "pvt driver select"
    depends on DRIVER_PVT

    config DRIVER_HG_PVT
        bool "HG PVT driver"
    config DRIVER_TIANQIN_PVT
        bool "TianQin PVT driver"
endchoice
```

## drivers/pwm/Kconfig
```kconfig
config DRIVER_PWM
    bool "Enable PWM driver"
    default n
    help
      Select this to enable PWM (Pulse Width Modulation) driver support
```

## drivers/qspi/Kconfig
```kconfig
config DRIVER_QFLASH
    bool "Enable QSPI Flash driver"
    default y
    help
      Select this to enable QSPI Flash driver support
```

## drivers/qspi_ctrl/Kconfig
```kconfig
config DRIVER_QSPI_CTRL
    bool "Enable QSPI controller driver"
    default y
    help
      Select this to enable QSPI controller driver support
```

## drivers/security/Kconfig
```kconfig
menu "security"

config DRIVER_EFUSE
    bool "Enable efuse driver"
    default y
    help
      Select this to enable efuse driver support

choice
    prompt "efuse driver select"
    depends on DRIVER_EFUSE

    config DRIVER_EFUSE_V1
        bool "efuse v1 driver"
    config DRIVER_EFUSE_V2
        bool "efuse v2 driver"
endchoice


config DRIVER_TRNG
    bool "Enable TRNG driver"
    default y
    help
      Select this to enable TRNG (True Random Number Generator) driver support

choice
    prompt "trng driver select"
    depends on DRIVER_TRNG

    config DRIVER_TRNG_DW
        bool "DesignWare TRNG driver"
    config DRIVER_TRNG_TH
        bool "TH TRNG driver"
endchoice

config DRIVER_TRNG_API_TEST
    bool "Enable TRNG API test"
    default n
    depends on DRIVER_TRNG
    help
        Select this to enable TRNG API test

config DRIVER_SM3
    bool "Enable SM3 driver"
    default y
    help
      Select this to enable SM3 hash calculation driver support

config DRIVER_SM2
    bool "Enable SM2 driver"
    default y
    help
      Select this to enable SM2 driver support
config USING_SM4
    bool "USING SM4"
    default y
    help
      Select this to enable SM4 driver support
endmenu
```

## drivers/sgpio/Kconfig
```kconfig
config DRIVER_SGPIO
    bool "Enable SGPIO driver"
    default y
    help
        Select this to enable SGPIO driver support

choice
    depends on DRIVER_SGPIO
    prompt "SGPIO driver select"
    config DRIVER_SGPIO_V1_1
        bool "SGPIO v1.1 driver"
        help
            SGPIO driver for TianQin
    config DRIVER_SGPIO_V2_0
        bool "SGPIO v2.0 driver"
        help
            SGPIO driver for SheShou
    config DRIVER_SGPIO_V1_0
        bool "SGPIO v1.0 driver"
        help
            SGPIO driver for TianHe/ShuangZi
endchoice

config DRIVER_SGPIO_API_TEST
    bool "Enable SGPIO API test"
    default n
    depends on DRIVER_SGPIO
    help
        Select this to enable SGPIO API test
```

## drivers/sm2/Kconfig
```kconfig
config DRIVER_SM2
    bool "Enable SM2 driver"
    default y
    help
      Select this to enable SM2 driver support
```

## drivers/sm3/Kconfig
```kconfig
config DRIVER_SM3
    bool "Enable SM3 driver"
    default y
    help
      Select this to enable SM3 hash calculation driver support
```

## drivers/sm4/Kconfig
```kconfig
config DRIVER_SM4
    bool "Enable SM4 driver"
    default y
    help
      Select this to enable SM4 driver support
```

## drivers/smbus/smbus/Kconfig
```kconfig
config USING_SMBUS
    bool "USING SMBUS"
    default y
    help
      Select this to use smbus driver
```
